## Kconfig
```kconfig
# SPDX-FileCopyrightText: 2025 Chen Linxuan <me@black-desk.cn>
#
# SPDX-License-Identifier: GPL-2.0-only

# TODO: Update module name and description as needed
config TEMPLATE_MODULE # TODO: Update config name to match your module
	tristate "Template kernel module" # TODO: Update module description
	default m
	help
	  A simple template kernel module that demonstrates basic
	  module initialization and cleanup.

	  The module prints "hello world" on load and "goodbye" on unload.

	  To compile this as a module, choose M here: the module will be
	  called template. # TODO: Update module name

config TEMPLATE_KUNIT_TEST # TODO: Update config name to match your module
	tristate "KUnit tests for template module" # TODO: Update module name in description
	depends on KUNIT
	depends on TEMPLATE_MODULE # TODO: Update dependency to match your module config
	default n
	help
	  Enable KUnit tests for the template module. # TODO: Update module name

	  This option builds additional test code that can be used to
	  verify the functionality of the template module using the # TODO: Update module name
	  KUnit testing framework.

	  If unsure, say N.
```
